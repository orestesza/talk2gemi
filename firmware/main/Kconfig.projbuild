## firmware/main/Kconfig.projbuild
```kconfig
menu "talk2gemi"
config TALK2GEMI_USB_DIAGNOSTICS
    bool "Enable local USB test console (development only)"
    default n
    help
        Allows bounded connection commands and injection of supplied PCM samples
        over the physical USB console. Never starts the microphone. Disable for
        accepted release builds.
endmenu
```

## releases/1.0-beta/source/firmware/sdkconfig.defaults
```kconfig
# --- 目标芯片 ---
CONFIG_IDF_TARGET="esp32c3"

# --- Flash ---
CONFIG_ESPTOOLPY_FLASHSIZE_8MB=y
CONFIG_ESPTOOLPY_HEADER_FLASHSIZE_UPDATE=n
CONFIG_PARTITION_TABLE_CUSTOM=y
CONFIG_PARTITION_TABLE_CUSTOM_FILENAME="partitions.csv"
CONFIG_PARTITION_TABLE_FILENAME="partitions.csv"

# --- 控制台: USB-Serial-JTAG (C3 原生 USB, GPIO18/19) ---
CONFIG_ESP_CONSOLE_USB_SERIAL_JTAG=y
CONFIG_ESP_CONSOLE_SECONDARY_NONE=y

# --- FreeRTOS ---
CONFIG_FREERTOS_HZ=1000

# --- LVGL ---
CONFIG_LV_COLOR_DEPTH_16=y
CONFIG_LV_DEF_REFR_PERIOD=20
CONFIG_LV_FONT_MONTSERRAT_14=y
CONFIG_LV_FONT_MONTSERRAT_20=y

# --- HTTP Server ---
CONFIG_HTTPD_MAX_REQ_HDR_LEN=1024
CONFIG_HTTPD_MAX_URI_LEN=512

# --- LWIP ---
CONFIG_LWIP_TCP_MSS=1436
CONFIG_LWIP_TCP_SND_BUF_DEFAULT=5744
CONFIG_LWIP_TCP_WND_DEFAULT=5744

# BLE central, encrypted bonded audio link, shared Wi-Fi/BLE radio.
CONFIG_BT_ENABLED=y
CONFIG_BT_NIMBLE_ENABLED=y
CONFIG_BT_NIMBLE_ROLE_CENTRAL=y
CONFIG_BT_NIMBLE_ROLE_PERIPHERAL=n
CONFIG_BT_NIMBLE_ROLE_BROADCASTER=n
CONFIG_BT_NIMBLE_ROLE_OBSERVER=y
CONFIG_BT_NIMBLE_MAX_CONNECTIONS=1
CONFIG_BT_NIMBLE_ATT_PREFERRED_MTU=247
CONFIG_BT_NIMBLE_NVS_PERSIST=y
CONFIG_BT_NIMBLE_SM_SC=y
CONFIG_BT_NIMBLE_SM_LEGACY=n
CONFIG_ESP_COEX_SW_COEXIST_ENABLE=y

CONFIG_ESP_WIFI_STATIC_RX_BUFFER_NUM=6

CONFIG_ESP_WIFI_DYNAMIC_RX_BUFFER_NUM=8

CONFIG_ESP_WIFI_DYNAMIC_TX_BUFFER_NUM=8

CONFIG_ESP_WIFI_MGMT_SBUF_NUM=8

CONFIG_ESP_WIFI_RX_BA_WIN=4

CONFIG_BT_CTRL_BLE_MAX_ACT=2

CONFIG_BT_NIMBLE_MSYS_1_BLOCK_COUNT=6

CONFIG_BT_NIMBLE_MSYS_2_BLOCK_COUNT=6

CONFIG_BT_NIMBLE_TRANSPORT_ACL_FROM_LL_COUNT=6

CONFIG_BT_NIMBLE_TRANSPORT_EVT_COUNT=10

CONFIG_BT_NIMBLE_TRANSPORT_EVT_DISCARD_COUNT=4

CONFIG_LV_MEM_SIZE_KILOBYTES=16

CONFIG_BT_NIMBLE_ROLE_PERIPHERAL=y

CONFIG_BT_NIMBLE_GATT_SERVER=y
CONFIG_BT_NIMBLE_GAP_SERVICE=y
CONFIG_BT_NIMBLE_SVC_GAP_DEVICE_NAME="talk2gemi"

CONFIG_BT_NIMBLE_L2CAP_COC_MAX_NUM=0

CONFIG_LV_FONT_MONTSERRAT_12=y
```
